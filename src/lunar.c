# include <reg52.h>

#define uchar unsigned char
#define uint unsigned int
static unsigned int LunarCalendarDay;

static code unsigned long LunarCalendarTable[60] = {
 
    0x4D4AB8,0x0D4A4C,0x0DA541,0x25AAB6,0x056A49,0x7AADBD,0x025D52,0x092D47,0x5C95BA,0x0A954E,/*2001-2010*/
    0x0B4A43,0x4B5537,0x0AD54A,0x955ABF,0x04BA53,0x0A5B48,0x652BBC,0x052B50,0x0A9345,0x474AB9,/*2011-2020*/
    0x06AA4C,0x0AD541,0x24DAB6,0x04B64A,0x69573D,0x0A4E51,0x0D2646,0x5E933A,0x0D534D,0x05AA43,/*2021-2030*/
    0x36B537,0x096D4B,0xB4AEBF,0x04AD53,0x0A4D48,0x6D25BC,0x0D254F,0x0D5244,0x5DAA38,0x0B5A4C,/*2031-2040*/

};
static code uchar jieqi[]=
{ 
       0x96,0xB4,0xA5,0xB5,0xA6,0xA6,0x87,0x88,0x88,0x78,0x87,0x86,     //2000   
       0xA5,0xB3,0xA5,0xA5,0xA6,0xA6,0x88,0x88,0x88,0x78,0x87,0x87,     //2001   
       0xA5,0xB4,0x96,0xA5,0x96,0x96,0x88,0x78,0x78,0x78,0x87,0x87,     //2002   
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       0x95,0xB4,0xA5,0xB4,0xA5,0xA6,0x97,0x87,0x87,0x78,0x87,0x96,     //2024   
  

    };

static code int MonthAdd[12] = {0,31,59,90,120,151,181,212,243,273,304,334};

static int LunarCalendar(int year,int month,int day)
{
    int Spring_NY,Sun_NY,StaticDayCount;
    int index,flag;
    //Spring_NY 记录春节离当年元旦的天数。
    //Sun_NY 记录阳历日离当年元旦的天数。

    if( ((LunarCalendarTable[year-2001] & 0x0060) >> 5) == 1)
        Spring_NY = (LunarCalendarTable[year-2001] & 0x001F) - 1;
    else
        Spring_NY = (LunarCalendarTable[year-2001] & 0x001F) - 1 + 31;

    Sun_NY = MonthAdd[month-1] + day - 1;

    if( (!(year % 4)) && (month > 2))
        Sun_NY++;

    //StaticDayCount记录大小月的天数 29 或30
    //index 记录从哪个月开始来计算。
    //flag 是用来对闰月的特殊处理。

    //判断阳历日在春节前还是春节后
    if (Sun_NY >= Spring_NY)//阳历日在春节后（含春节那天）
    {
        Sun_NY -= Spring_NY;
        month = 1;
        index = 1;
        flag = 0;
        if( ( LunarCalendarTable[year - 2001] & (0x80000 >> (index-1)) ) ==0)
            StaticDayCount = 29;
        else
            StaticDayCount = 30;

        while(Sun_NY >= StaticDayCount)
        {
            Sun_NY -= StaticDayCount;
            index++;

            if(month == ((LunarCalendarTable[year - 2001] & 0xF00000) >> 20) )
            {
                flag = ~flag;
                if(flag == 0)
                    month++;
            }
            else
                month++;
            if( ( LunarCalendarTable[year - 2001] & (0x80000 >> (index-1)) ) ==0)
                StaticDayCount=29;
            else
                StaticDayCount=30;
        }
        day = Sun_NY + 1;
    }
    else//阳历日在春节前
    { 
        Spring_NY -= Sun_NY;
        year--;
        month = 12;

        if ( ((LunarCalendarTable[year - 2001] & 0xF00000) >> 20) == 0)
            index = 12;
        else
            index = 13;
	    
        flag = 0;

        if( ( LunarCalendarTable[year - 2001] & (0x80000 >> (index-1)) ) ==0)
            StaticDayCount = 29;
        else
            StaticDayCount = 30;

        while(Spring_NY > StaticDayCount)
        {
            Spring_NY -= StaticDayCount;
            index--;

            if(flag == 0)
                month--;

            if(month == ((LunarCalendarTable[year - 2001] & 0xF00000) >> 20))
                flag = ~flag;

            if( ( LunarCalendarTable[year - 2001] & (0x80000 >> (index-1)) ) ==0)
                StaticDayCount = 29;
            else
                StaticDayCount = 30;
         }
         day = StaticDayCount - Spring_NY + 1;
    }

    LunarCalendarDay = day;
    LunarCalendarDay |= (month << 6);
    if(month == ((LunarCalendarTable[year - 1901] & 0xF00000) >> 20))
        return 1;
    else
        return 0;

}


int lunar_calendar(int *solar, uchar *lunar)
{
    int flag=0;

    if(LunarCalendar(solar[0],solar[1],solar[2]))
    {
        lunar[0] = (LunarCalendarDay & 0x3C0) >> 6;
				flag = 1; //闰月
    }
    else
    {
        lunar[0] = (LunarCalendarDay & 0x3C0) >> 6;
    }

    lunar[1] = LunarCalendarDay & 0x3F;
    
    return flag;
}

/*
 * 农历转换
*/
void turn_lunar_calendar(uint year,uchar month,uchar day, uchar *lunar)
{
	int solar[3];

	solar[0] = year;
	solar[1] = month;
	solar[2] = day;

	lunar_calendar(solar, lunar);
}
uchar judgeSolar(uint year,uchar month,uchar day)
{
	uchar temp;
	uint location = (year - 2000) * 12 + month - 1;
	    if(day<15)
        {
        temp=15-day;
        if((jieqi[location] >> 4) == temp) return ((month-1) * 2);
        else return (0);
        }
    else if(day==15) return (0);
    else
        {
        temp=day-15;
        if((jieqi[location]&0x0f)==temp) return ((month-1) * 2 + 1);
        else return (0);
        }
}
